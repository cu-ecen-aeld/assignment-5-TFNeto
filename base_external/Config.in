## base_external/Config.in
```kconfig
config BR2_PACKAGE_PROJECT_BASE
    source "BR2_EXTERNAL_project_base_PATH/package/aesd-assignments/Config.in"
```

## base_external/package/aesd-char/Config.in
```kconfig
config BR2_PACKAGE_AESD_CHAR
	bool "aesd-char"
	depends on BR2_LINUX_KERNEL
	help
	  aesd-char package for device driver
```
